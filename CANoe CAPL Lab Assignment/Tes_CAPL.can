/*@!Encoding:1252*/
includes
{
  
}

variables
{
  int Ig_stat = 0;
}

testcase test_case_1()//Ignition ON condition check
{
  TestCaseDescription("Test case is used to check the IGN ON Conditions of SUT");
  write ("inside test_case_1");
  putValue(Ignition_Status,Ig_stat);
  if(Ig_stat == 1)
  {
    write("Ignition is ON");
    testStepPass("TestCase1 Passed");
  }
  else if (Ig_stat != 1)
  {
    write("Ignition is OFF");
    testStepWarning("TestCase1 in warning state, IGN still Off");
  }
  //testWaitForTimeout(1000);
  //test_1();
  //testStepPass(("Life");
}

testcase test_case_2()//Ignition OFF condition check
{
  TestCaseDescription("Test case is used to check the IGN OFF Conditions of SUT");
  write ("inside test_case_2");
  putValue(Ignition_Status,Ig_stat);
  if(Ig_stat == 0)
  {
    write("Ignition is OFF");
    testStepPass("TestCase2 Passed");
  }
  else if (Ig_stat != 0)
  {
    write("Ignition is ON");
    testStepFail("TestCase2 Failed");
  }
}

testcase test_case_3()//Ignition OFF condition check
{
  TestCaseDescription("FPres = HIGH, FTemp = NORMAL,");
  TestCaseDescription("RPres = NORMAL, RTemp = LOW,");
  write ("inside test_case_3");
  
  if(testWaitForTesterConfirmation("Is Front Pressure and Rear Temperature Lights are ON? (press Q before answer)"))
  {
    testStepPass("Front Pressure and Rear Temperature Lights were ON");
  }
  else
  {
    testStepFail("Front Pressure and/or Rear Temperature Lights were OFF");
  }
}

testcase test_case_4()//Ignition OFF condition check
{
  TestCaseDescription("FPres = NORMAL, FTemp = LOW,");
  TestCaseDescription("RPres = HIGH, RTemp = NORMAL,");
  write ("inside test_case_4");
  
  if(testWaitForTesterConfirmation("Is Rear Pressure and Front Temperature Lights are ON? (press W before answer)"))
  {
    testStepPass("Front Pressure and Rear Temperature Lights were ON");
  }
  else
  {
    testStepFail("Front Pressure and/or Rear Temperature Lights were OFF");
  }
  
}

testcase test_case_5()//Ignition OFF condition check
{
  TestCaseDescription("FPres = LOW, FTemp = HIGH,");
  TestCaseDescription("RPres = NORMAL, RTemp = NORMAL");
  write ("inside test_case_5");
  
  if(testWaitForTesterConfirmation("Is Front Pressure and Front Temperature Lights are ON? (press E before answer)"))
  {
    testStepPass("Front Pressure and Rear Temperature Lights were ON");
  }
  else
  {
    testStepFail("Front Pressure and/or Rear Temperature Lights were OFF");
  }
}

testcase test_case_6()//Ignition OFF condition check
{
  TestCaseDescription("FPres = , FTemp = ,");
  TestCaseDescription("RPres = , RTemp = ,");
  write ("inside test_case_6");
  
}

testcase test_case_7()//Ignition OFF condition check
{
  TestCaseDescription("FPres = , FTemp = ,");
  TestCaseDescription("RPres = , RTemp = ,");
  write ("inside test_case_7");
  
}

testcase test_case_8()//Ignition OFF condition check
{
  TestCaseDescription("FPres = , FTemp = ,");
  TestCaseDescription("RPres = , RTemp = ,");
  write ("inside test_case_8");
  
}

void MainTest ()
{
  TestModuleTitle("TPMS Test Report");
  TestModuleDescription("This test module calls some test cases to demonstrate ");
  TestModuleDescription("the functionality of TPMS.");
  TestReportAddSUTInfo("Company", "KPIT");
  TestReportAddSUTInfo("Serial No.", "A012345BC");
  TestReportAddSUTInfo("Manufactured", "2018-08-01");
  TestReportAddEngineerInfo("Test Engineer", "D.Patel");

  //execute test cases
  test_case_1();
  test_case_2(); 
  test_case_3();
  test_case_4();
  test_case_5();
}






/*

Pressure range --> 32 to 35
Temperature Range --> 70 to 100
Test 3
  Front:
    Pres: High    = 40
    Temp: Normal  = 75
  Rear:
    Pres: Normal  = 32
    Temp: Low     = 60

Test 4
  Front:
    Pres: Normal = 35
    Temp: Low    = 69
  Rear:
    Pres: High   = 37
    Temp: Normal = 100

Test 5
  Front:
    Pres: Low    = 31
    Temp: High   = 101
  Rear:
    Pres: Normal = 35
    Temp: Normal = 70
*/