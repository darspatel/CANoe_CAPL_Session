VERSION ""

NS_ :

BS_:

BU_: Sensor_2 Sensor_1 TPMS_ECU

BO_ 68 Sensor2Data: 3 Sensor_2
 SG_ RearLeft_Temp_Feedback : 24|8@1+ (1,0) [0|255] "F" Vector__XXX
 SG_ RearLeft_Pressure_Feedback : 16|8@1+ (1,0) [0|255] "psi" Vector__XXX
 SG_ RearRight_Temp_Feedback : 8|8@1+ (1,0) [0|255] "F" Vector__XXX
 SG_ RearRight_Pressure_Feedback : 0|8@1+ (1,0) [0|255] "psi" Vector__XXX

BO_ 67 Sensor1Data: 3 Sensor_1
 SG_ FrontLeft_Temp_Feedback : 24|8@1+ (1,0) [0|255] "F" Vector__XXX
 SG_ FrontLeft_Pressure_Feedback : 16|8@1+ (1,0) [0|255] "psi" Vector__XXX
 SG_ FrontRight_Temp_Feedback : 8|8@1+ (1,0) [0|255] "F" Vector__XXX
 SG_ FrontRight_Pressure_Feedback : 0|8@1+ (1,0) [0|255] "psi" Vector__XXX

BA_DEF_  "BusType" STRING ;
BA_DEF_DEF_  "BusType" "CAN";
